## meta-local/conf/layer.conf
```bitbake
# meta-local layer for custom recipes
BBPATH .= ":${LAYERDIR}"
BBFILES += "${LAYERDIR}/recipes-*/*/*.bb"

LAYERSERIES_COMPAT_poky = "dunfell kirkstone langdale mickledore nanbield scarthgap"
```

## meta-my-layer/conf/layer.conf
```bitbake
# Example layer.conf for meta-my-layer
# Adjust LAYERDIR if you move this layer
BBPATH .= ":${LAYERDIR}"
BBFILES += "${LAYERDIR}/recipes-*/*/*.bb ${LAYERDIR}/recipes-*/*/*.bbappend"

BBFILE_COLLECTIONS += "my-layer"
BBFILE_PATTERN_my-layer = "^${LAYERDIR}/"
BBFILE_PRIORITY_my-layer = "6"

LAYERSERIES_COMPAT_my-layer = "dunfell gatesgarth hardknott honister kirkstone mickledore nanbield scarthgap"
```

## meta-server/conf/layer.conf
```bitbake
# We have a conf and classes directory, add to BBPATH
BBPATH .= ":${LAYERDIR}"

# We have recipes-* directories, add to BBFILES
BBFILES += "${LAYERDIR}/recipes-*/*/*.bb ${LAYERDIR}/recipes-*/*/*.bbappend"

BBFILE_COLLECTIONS += "meta-server"
BBFILE_PATTERN_meta-server = "^${LAYERDIR}/"
BBFILE_PRIORITY_meta-server = "6"

LAYERSERIES_COMPAT_meta-server = "dunfell gatesgarth hardknott honister kirkstone mickledore nanbield scarthgap"
```
